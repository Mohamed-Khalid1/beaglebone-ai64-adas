## yocto/meta-bbai64-minimal/conf/layer.conf
```bitbake
BBPATH .= ":${LAYERDIR}"

BBFILES += "${LAYERDIR}/recipes-*/*/*.bb \
            ${LAYERDIR}/recipes-*/*/*.bbappend"

BBFILE_COLLECTIONS += "bbai64-minimal"
BBFILE_PATTERN_bbai64-minimal = "^${LAYERDIR}/"

# Priority 14 — sits above meta-edgeai (13) so our bbappends win
BBFILE_PRIORITY_bbai64-minimal = "14"

LAYERDEPENDS_bbai64-minimal = "core meta-arago-distro meta-ti-bsp openembedded-layer"
LAYERSERIES_COMPAT_bbai64-minimal = "scarthgap"
```
